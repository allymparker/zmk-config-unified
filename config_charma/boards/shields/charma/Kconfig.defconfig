## config_charma/boards/shields/charma/Kconfig.defconfig
```kconfig
# Copyright (c) 2023 Ally Parker
# SPDX-License-Identifier: MIT

if SHIELD_CHARMA_LEFT

config ZMK_KEYBOARD_NAME
    default "Charma"

config ZMK_SPLIT_ROLE_CENTRAL
    default y

endif

if SHIELD_CHARMA_LEFT || SHIELD_CHARMA_RIGHT

config ZMK_SPLIT
    default y

endif

if SHIELD_CHARMA_DONGLE

config ZMK_KEYBOARD_NAME
    default "Charma"

config ZMK_SPLIT_ROLE_CENTRAL
    default y

config ZMK_SPLIT
    default y

# For split keyboard with left and right halves
config ZMK_SPLIT_BLE_CENTRAL_PERIPHERALS
    default 2

# Set this to ZMK_SPLIT_BLE_CENTRAL_PERIPHERALS + your desired number of BT profiles (default is 5)
config BT_MAX_CONN
    default 7

# Set this to the same number as BT_MAX_CONN
config BT_MAX_PAIRED
    default 7

endif # SHIELD_CHARMA_DONGLE

if ZMK_DISPLAY

config I2C
    default y

config SSD1306
    default y

endif # ZMK_DISPLAY

if LVGL

config LV_Z_VDB_SIZE
    default 64

config LV_DPI_DEF
    default 148

config LV_Z_BITS_PER_PIXEL
    default 1

choice LV_COLOR_DEPTH
    default LV_COLOR_DEPTH_1
endchoice

endif # LVGL
```

## config_charma/boards/shields/charma/Kconfig.shield
```kconfig
# Copyright (c) 2023 Ally Parker
# SPDX-License-Identifier: MIT

config SHIELD_CHARMA_LEFT
    def_bool $(shields_list_contains,charma_left)

config SHIELD_CHARMA_RIGHT
    def_bool $(shields_list_contains,charma_right)

config SHIELD_CHARMA_DONGLE
    def_bool $(shields_list_contains,charma_dongle)
```

## config_charma/west.yml
```yaml
manifest:
  remotes:
    - name: zmkfirmware
      url-base: https://github.com/zmkfirmware
    - name: allymparker
      url-base: https://github.com/allymparker
    - name: englmaxi
      url-base: https://github.com/englmaxi
  projects:
    - name: zmk
      remote: zmkfirmware
      revision: main
      import: app/west.yml
    - name: zmk-tri-state
      remote: allymparker
      revision: main
      path: modules/zmk/tri-state
    - name: zmk-rgbled-widget
      remote: allymparker
      revision: main
    - name: zmk-dongle-display
      remote: englmaxi
      revision: main
  self:
    path: config
```

## config_corneroll/west.yml
```yaml
manifest:
  remotes:
    - name: zmkfirmware
      url-base: https://github.com/zmkfirmware
    - name: allymparker
      url-base: https://github.com/allymparker
  projects:
    - name: zmk
      remote: allymparker
      revision: allymparker/corneroll
      import: app/west.yml
    - name: zmk-tri-state
      remote: allymparker
      revision: main
      path: modules/zmk/tri-state
  self:
    path: config
```

## config_zen/west.yml
```yaml
manifest:
  remotes:
    - name: zmkfirmware
      url-base: https://github.com/zmkfirmware
    - name: allymparker
      url-base: https://github.com/allymparker
    - name: caksoylar
      url-base: https://github.com/caksoylar
  projects:
    - name: zmk
      remote: caksoylar
      revision: caksoylar/zen-v1+v2
      import: app/west.yml
    - name: zmk-tri-state
      remote: allymparker
      revision: main
      path: modules/zmk/tri-state
  self:
    path: config
```
